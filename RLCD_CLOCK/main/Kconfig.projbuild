## RLCD_CLOCK/main/Kconfig.projbuild
```kconfig
menu "Xiaozhi AI"

config XIAOZHI_AI_OTA_URL
    string "Xiaozhi activation URL"
    default "https://api.tenclass.net/xiaozhi/ota/"
    help
        Official XiaoZhi activation endpoint. The weather-clock OTA service is not affected.

endmenu
```

## docs/Power Demo/sdkconfig.defaults
```kconfig
CONFIG_IDF_TARGET="esp32s3"
CONFIG_ESPTOOLPY_FLASHMODE_QIO=y
CONFIG_ESPTOOLPY_FLASHSIZE_16MB=y
CONFIG_PARTITION_TABLE_CUSTOM=y
CONFIG_PARTITION_TABLE_CUSTOM_FILENAME="partitions.csv"

# 1-bit 帧缓冲只有 15 KB，放内部 RAM；不启动 PSRAM 可缩短每次深睡唤醒。
# CONFIG_SPIRAM is not set

# 裁剪字体由 Demo 自带的最小 1-bit 查询器读取，不依赖 LVGL。

# 日更 NTP 窗口使用尽量小的 Wi-Fi 缓冲；稳态 Wi-Fi 完全关闭。
CONFIG_ESP_WIFI_STATIC_RX_BUFFER_NUM=6
CONFIG_ESP_WIFI_DYNAMIC_RX_BUFFER_NUM=12
CONFIG_ESP_WIFI_RX_BA_WIN=3
# CONFIG_ESP_WIFI_NVS_ENABLED is not set
# CONFIG_ESP_WIFI_ENABLE_WPA3_SAE is not set
# CONFIG_ESP_WIFI_ENABLE_WPA3_OWE_STA is not set
# CONFIG_ESP_WIFI_GMAC_SUPPORT is not set
# CONFIG_ESP_WIFI_SOFTAP_SUPPORT is not set
# CONFIG_ESP_WIFI_ENTERPRISE_SUPPORT is not set
CONFIG_LWIP_SNTP_MAX_SERVERS=3

CONFIG_FREERTOS_HZ=100
CONFIG_COMPILER_OPTIMIZATION_SIZE=y
CONFIG_BOOTLOADER_LOG_LEVEL_WARN=y
CONFIG_LOG_DEFAULT_LEVEL_WARN=y
CONFIG_LOG_MAXIMUM_LEVEL_INFO=y
```
